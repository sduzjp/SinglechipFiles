//公曆轉農曆(1901-2100)
//亦木明 2008.1.11
//2018.12.30清枫城主测试，发现存在问题，通过仿真一步步走找出问题所在，并作出修正
//原文在哪忘了，只知道作者有“亦木明”的标注，如有侵权联系删除
#include "reg51.h"//可修改为51的头文件   
#define uchar unsigned char
#define uint unsigned int

#define TRUE  1
//公历年对应的农历数据,每年三字节,
//格式第一字节BIT7-4 位表示闰月月份,值为0 为无闰月,BIT3-0 对应农历第1-4 月的大小
//第二字节BIT7-0 对应农历第5-12 月大小,第三字节BIT7 表示农历第13 个月大小
//月份对应的位为1 表示本农历月大(30 天),为0 表示小(29 天).
//第三字节BIT6-5 表示春节的公历月份,BIT4-0 表示春节的公历日期
//每年的數據對應在數組中的位置庫 (200-(2100-year)-1)*3+Offset1  
//0x09,0x2d,0x47, //2008  0x47 01000111
//0x4d,0x4A,0xB8, //2001

typedef struct spdate
{
        char         cYear;
        char        cMon;
        char        cDay;
}SPDATE;


uchar code Data[]={

0x04,0xAe,0x53, //1901  0        (200-(2100-1901)-1)*3=0
0x0A,0x57,0x48, //1902        3   (200-(2100-1902)-1)*3=3
0x55,0x26,0xBd, //1903        6        (200-(2100-1903)-1)*3=3
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0x0d,0x53,0x49, //2100
};

uchar code Mon1[2][13]={0,31,28,31,30,31,30,31,31,30,31,30,31,
                                  0,31,29,31,30,31,30,31,31,30,31,30,31};

SPDATE Spdate;
//獲得當年春節的公曆日期
SPDATE GetSpringDay(uchar GreYear,uchar GreMon,uchar GreDay)
{
        //0x09,0x2d,0x47, //2008  0x47 01000111 
        int day;
    	uchar i,Flag,F;
        uint Offset1;//出现问题在这里，原本定义为uchar类型，下面计算时超出范围导致错误，进行修改为uint类型后，验证正常
        unsigned char L=0x01,Flag1=1;
        unsigned int  Temp16,L1=0x0800;
        //第三字节BIT6-5 表示春节的公历月份,BIT4-0 表示春节的公历日期
        Spdate.cYear=GreYear ;
        Spdate.cMon=(Data[(200-(100-GreYear)-1)*3+2]&0x60)>>5; //计算春节公历月份
        Spdate.cDay=(Data[(200-(100-GreYear)-1)*3+2])&0x1f;    //计算春节公历日期

        //判断平年，闰年
        if( (!(GreYear%4) && (GreYear%100)) || !(GreYear%400) ) Flag=1; 
        else Flag=0;
        
        if(Spdate.cMon>GreMon)                                                                //春节离公历日期的天数
        {
           day=Mon1[Flag][GreMon]-GreDay;
           for(i=GreMon+1;i<=Spdate.cMon-1;i++)
                        day+=Mon1[Flag][i];
           day+=Spdate.cDay;
           F=1;
        }
        else if(Spdate.cMon<GreMon) //春節的月份小於目標的月份
        {
                day=Mon1[Flag][Spdate.cMon]-Spdate.cDay;  
                for(i=Spdate.cMon+1;i<=GreMon-1;i++)
                        day+=Mon1[Flag][i];
                day+=GreDay;                                //          000000000000000000000000000000000000000000000000000000000000000000
                F=0;
        }
        else
        {
                if(Spdate.cDay>GreDay)
                {
                        day=Spdate.cDay-GreDay;
                        F=1;
                }
                else if(Spdate.cDay<GreDay)
                {
                        day=GreDay-Spdate.cDay;
                        F=0;
                }
                else day=0;
        }                 

        Spdate.cYear=Spdate.cYear;
        Spdate.cMon=1;
        Spdate.cDay=1;

        if(!day) return Spdate ;

        if(F)    //春节在公历日期后
        {
                Spdate.cYear--;
                Spdate.cMon=12;
                //这边Offset1计算会出现超范围，因此把uchar类型改为uint后正常
                Offset1=(200-(100-Spdate.cYear)-1)*3;
                while(TRUE)
                {
                        //格式第一字节BIT7-4 位表示闰月月份,值为0 为无闰月,BIT3-0 对应农历第1-4 月的大小
                        //第二字节BIT7-0 对应农历第5-12 月大小,第三字节BIT7 表示农历第13 个月大小
                        //0x4d,0x4A,0xB8, //2001
                        if(Data[Offset1+1]&L) 
                                day-=30;
                        else
                                day-=29;
                        L<<=1;
                        if(((Data[Offset1+0]&0xf0)>>4)==Spdate.cMon && Flag1)//(Data[Offset1+0]&0xf0)>>4判断是否是闰月1平月0 
                        {
                                Flag1=0;
                                if(Data[Offset1+2]&0x80) day-=30; else day-=29;
                                continue;
                        }
                        if(day>0) Spdate.cMon--; 
                        else break;
                        
                        
                }
                Spdate.cDay=-day+1;
        }
        
        if(!F)
        {
                Spdate.cMon=1;
                //这边Offset1计算会出现超范围，因此把uchar类型改为uint后正常
                Offset1=(200-(100-Spdate.cYear)-1)*3;
                Temp16=(Data[Offset1+0]<<8)+Data[Offset1+1];
                while(TRUE)
                {
                        if(Temp16 & L1) day-=30; else day-=29;
                        if(day>=0) 
                                Spdate.cMon++; 
                        else if(day<0)
                        {
                                if(Temp16 & L1) day+=30; else day+=29;
                                break;
                        }
                        L1>>=1;
                        //格式第一字节BIT7-4 位表示闰月月份,值为0 为无闰月,BIT3-0 对应农历第1-4 月的大小
                        //第二字节BIT7-0 对应农历第5-12 月大小,第三字节BIT7 表示农历第13 个月大小
                        if(((Data[Offset1+0]&0xf0)>>4)==(Spdate.cMon-1) && Flag1) //闰月
                        {
                                Flag1=0;
                                Spdate.cMon--;
                                if(Temp16 & L1) day-=30; else day-=29;
                                if(day>=0) 
                                        Spdate.cMon++; 
                                else if(day<0)
                                {
                                        if(Temp16 & L1) day+=30; else day+=29;
                                        break;
                                }
                                L1>>=1;
                        }
                }
                Spdate.cDay=day+1;
        }
    return Spdate;
}

/*bit YearFlag(uchar cYear) //判断平年，闰年
{
   if( (!(cYear%4) && (cYear%100)) || !(cYear%400) ) return 1; else return 0;
}

//目標日期是星期幾
uchar GetWeekDay(uchar cYear,uchar cMon,uchar cDay)
{
        char i;
        int  Sum=0,tmpyear=2000+cYear;
        for(i=1;i<=cMon-1;i++)
                Sum+=Mon1[YearFlag(cYear)][i];
        Sum+=cDay-1;
        
        return (((tmpyear-1)+(tmpyear-1)/4-(tmpyear-1)/100+(tmpyear-1)/400+Sum)%7)+1;
}*/

void main()
{
        for(;;)
        {
        GetSpringDay(18,12,30);        //输入数据为十进制，不是BCD码格式，这个请注意

        }
}


 
